## drivers/my_i2c_mcp9808/Kconfig
```kconfig
# MCP9808 temperature sensor configuration options

# Copyright (c) 2016 Intel Corporation
# SPDX-License-Identifier: Apache-2.0

menuconfig MY_I2C_MCP9808
	bool "MCP9808 temperature sensor"
	default y
	select I2C
	help
	  Enable driver for MCP9808 temperature sensor.
```

## drivers/my_uart_peripheral_b/Kconfig
```kconfig
menu "My uart peripheral-b"
config MY_UART_PERIPHERAL_B
    bool "Enable my uart peripheral-b"
    depends on UART_INTERRUPT_DRIVEN && GPIO

config MY_UART_PERIPHERAL_B_RX_BUF_SIZE
    int "rx buffer size (bytes)"
    default 64
    range 0 2047
    help
        Size of uart rx buffer. Will be allocated for each device.

config MY_UART_PERIPHERAL_B_TX_BUF_WORDS
    int "tx buffer size (words)"
    default 16
    range 0 511
    help
        Size of uart tx buffer (in 32-bit words). Will be allocated for each device.

config MY_UART_PERIPHERAL_B_TX_BUFFERING_BUF_WORDS
    int "tx buffering buffer size (words)"
    default 128
    range 0 511
    help
        Size of uart tx buffering buffer (in 32-bit words). Will be allocated for each device.

module = MY_UART_PERIPHERAL_B
module-str = My uart peripheral-b
source "subsys/logging/Kconfig.template.log_config"
endmenu
```

## dts/bindings/memo.txt
```
https://docs.zephyrproject.org/latest/build/dts/bindings-intro.html

上記より引用↓
====
Where bindings are located¶
Binding file names usually match their compatible: lines. For example, the above example binding would be named foo-company,bar-device.yaml by convention.

The build system looks for bindings in dts/bindings subdirectories of the following places:

the zephyr repository

your application source directory

your board directory

any shield directories

any directories manually included in the DTS_ROOT CMake variable

any module that defines a dts_root in its Build settings

The build system will consider any YAML file in any of these, including in any subdirectories, when matching nodes to bindings. A file is considered YAML if its name ends with .yaml or .yml.

Warning

The binding files must be located somewhere inside the dts/bindings subdirectory of the above places.

For example, if my-app is your application directory, then you must place application-specific bindings inside my-app/dts/bindings. So my-app/dts/bindings/serial/my-company,my-serial-port.yaml would be found, but my-app/my-company,my-serial-port.yaml would be ignored.
====

→ なので dts/bindings の下に foo-company,bar-device.yaml の名前で格納した
```
